## CMakeLists.txt
```
# SPDX-License-Identifier: MIT

cmake_minimum_required(VERSION 3.20.0)

set(PQCP_LOCAL_MODULE_ROOT "${CMAKE_CURRENT_LIST_DIR}/../..")
include(${PQCP_LOCAL_MODULE_ROOT}/cmake/pqcp_local_module.cmake)

find_package(Zephyr REQUIRED HINTS $ENV{ZEPHYR_BASE})
project(pqcp_bench_protocol)

target_sources(app PRIVATE src/main.c)
```

## prj.conf
```kconfig
# PQCP Protocol Benchmark Sample
CONFIG_PQCP=y
CONFIG_PQCP_MLKEM=y
CONFIG_PQCP_MLDSA=y

# Production-safe entropy source for benchmark runs
CONFIG_ENTROPY_GENERATOR=y
CONFIG_PQCP_RNG_ZEPHYR_ENTROPY=y

# Benchmarking and stack analysis
CONFIG_PQCP_BENCH=y
CONFIG_PQCP_BENCH_ITERATIONS=5
CONFIG_THREAD_STACK_INFO=y
CONFIG_INIT_STACKS=y

# Stack sizing for ML-DSA-87
CONFIG_MAIN_STACK_SIZE=131072

# Logging and timing
CONFIG_LOG=y
CONFIG_LOG_DEFAULT_LEVEL=3
CONFIG_LOG_PRINTK=n
CONFIG_TIMING_FUNCTIONS=y
```

## overlay-sanitize.conf
```kconfig
# Native-simulator sanitizer coverage for the protocol benchmark sample.
#
# ASan/UBSan check for memory bugs and UB, a single iteration is
# sufficient to exercise every crypto + mbedTLS path once. The default
# 5-iteration benchmark loop (prj.conf) is a perf run, not a coverage
# run, and multiplies native_sim + sanitizer runtime by 5x to no
# additional coverage benefit. Lowering it here keeps the release-gate
# sanitizer step within its 1200s budget on GitHub-hosted runners.

CONFIG_ASAN=y
CONFIG_UBSAN=y
CONFIG_PQCP_BENCH_ITERATIONS=1
```

## src/main.c
```c
/*
 * SPDX-License-Identifier: MIT
 *
 * PQCP Protocol Benchmark Sample
 */

#include <zephyr/sys/printk.h>

#include <pqcp_zephyr/bench.h>

int main(void)
{
    printk("\n");
    printk("========================================\n");
    printk("  PQCP Protocol Benchmark Sample\n");
    printk("========================================\n\n");
    printk("Running protocol self-test benchmarks with %d iterations per suite\n",
           CONFIG_PQCP_BENCH_ITERATIONS);

    pqcp_bench_run_protocol_all();

    printk("\n========================================\n");
    printk("  Protocol benchmark completed!\n");
    printk("========================================\n");

    return 0;
}
```
