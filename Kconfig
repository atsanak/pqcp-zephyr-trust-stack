## tests/ztest_deployment_evidence_verdict/testcase.yaml
```yaml
# SPDX-License-Identifier: LicenseRef-Proprietary-Collaborative-Evaluation
tests:
  pqcp.deployment_evidence_verdict:
    tags:
      - pqcp
      - deployment
      - evidence
    harness: ztest
    platform_allow:
      - qemu_x86_64
    integration_platforms:
      - qemu_x86_64
    timeout: 120
```

## tests/ztest_deployment_evidence_verdict_replay/testcase.yaml
```yaml
# SPDX-License-Identifier: MIT
tests:
  pqcp.deployment_evidence_verdict_replay:
    tags:
      - pqcp
      - deployment
      - evidence
    harness: ztest
    platform_allow:
      - qemu_x86_64
    integration_platforms:
      - qemu_x86_64
    timeout: 120
```

## tests/ztest_deployment_passport_signature/testcase.yaml
```yaml
# SPDX-License-Identifier: MIT
tests:
  pqcp.deployment_passport_signature:
    tags:
      - pqcp
      - deployment
      - evidence
      - crypto
    harness: ztest
    platform_allow:
      - qemu_x86_64
    integration_platforms:
      - qemu_x86_64
    timeout: 300
```

## tests/ztest_deployment_tamper_matrix/testcase.yaml
```yaml
tests:
  pqcp.deployment.tamper_matrix:
    tags: [pqcp, deployment, evidence, negative]
    harness: ztest
    platform_allow: [qemu_x86_64]
    integration_platforms: [qemu_x86_64]
    timeout: 180
```

## tests/ztest_deployment_tamper_matrix_audit/testcase.yaml
```yaml
tests:
  pqcp.deployment.tamper_matrix_audit:
    tags: [pqcp, deployment, evidence, audit]
    harness: ztest
    platform_allow: [qemu_x86_64]
    integration_platforms: [qemu_x86_64]
    timeout: 180
```

## tests/ztest_deployment_tamper_matrix_replay/testcase.yaml
```yaml
tests:
  pqcp.deployment.tamper_matrix_replay:
    tags: [pqcp, deployment, evidence, replay]
    harness: ztest
    platform_allow: [qemu_x86_64]
    integration_platforms: [qemu_x86_64]
    timeout: 180
```

## tests/ztest_edge_model/testcase.yaml
```yaml
# SPDX-License-Identifier: LicenseRef-Proprietary-Collaborative-Evaluation
tests:
  pqcp.edge_model:
    tags:
      - pqcp
      - edge
      - crypto
    harness: ztest
    platform_allow:
      - qemu_x86_64
    integration_platforms:
      - qemu_x86_64
    timeout: 300
```

## tests/ztest_edge_security/testcase.yaml
```yaml
tests:
  pqcp.edge_security:
    harness: ztest
    platform_allow:
      - qemu_x86_64
    integration_platforms:
      - qemu_x86_64
    tags:
      - pqcp
      - edge
      - security
    timeout: 300
```

## tests/ztest_evidence_continuity/testcase.yaml
```yaml
# SPDX-License-Identifier: LicenseRef-Proprietary-Collaborative-Evaluation
tests:
  pqcp.evidence_continuity:
    tags:
      - pqcp
      - evidence
      - evidence
      - crypto
    harness: ztest
    platform_allow:
      - qemu_x86_64
    integration_platforms:
      - qemu_x86_64
    timeout: 300
```

## tests/ztest_evidence_transcript/testcase.yaml
```yaml
# SPDX-License-Identifier: LicenseRef-Proprietary-Collaborative-Evaluation
tests:
  pqcp.evidence_transcript:
    tags:
      - pqcp
      - evidence
      - evidence
    harness: ztest
    platform_allow:
      - qemu_x86_64
    integration_platforms:
      - qemu_x86_64
    timeout: 120
```
