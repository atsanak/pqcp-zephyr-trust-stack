## build/Kconfig/arch/Kconfig.tmp
```kconfig
# Load Zephyr Arch Kconfig descriptions.
osource "/Users/angelostsanaktsidis/code/PQC/zephyr-ws/zephyr/arch/rx/Kconfig"
osource "/Users/angelostsanaktsidis/code/PQC/zephyr-ws/zephyr/arch/x86/Kconfig"
osource "/Users/angelostsanaktsidis/code/PQC/zephyr-ws/zephyr/arch/xtensa/Kconfig"
osource "/Users/angelostsanaktsidis/code/PQC/zephyr-ws/zephyr/arch/sparc/Kconfig"
osource "/Users/angelostsanaktsidis/code/PQC/zephyr-ws/zephyr/arch/riscv/Kconfig"
osource "/Users/angelostsanaktsidis/code/PQC/zephyr-ws/zephyr/arch/posix/Kconfig"
osource "/Users/angelostsanaktsidis/code/PQC/zephyr-ws/zephyr/arch/openrisc/Kconfig"
osource "/Users/angelostsanaktsidis/code/PQC/zephyr-ws/zephyr/arch/mips/Kconfig"
osource "/Users/angelostsanaktsidis/code/PQC/zephyr-ws/zephyr/arch/arm64/Kconfig"
osource "/Users/angelostsanaktsidis/code/PQC/zephyr-ws/zephyr/arch/arm/Kconfig"
osource "/Users/angelostsanaktsidis/code/PQC/zephyr-ws/zephyr/arch/arc/Kconfig"
```

## build/Kconfig/boards/Kconfig.defconfig
```kconfig
# Load Zephyr board defconfig descriptions.
osource "/Users/angelostsanaktsidis/code/PQC/zephyr-ws/zephyr/boards/qemu/x86/Kconfig.defconfig"
```

## build/Kconfig/boards/Kconfig.sysbuild.tmp
```kconfig
# Load Sysbuild board Kconfig descriptions.
osource "/Users/angelostsanaktsidis/code/PQC/zephyr-ws/zephyr/boards/qemu/x86/Kconfig.sysbuild"
```

## build/Kconfig/soc/Kconfig
```kconfig
# Load Zephyr SoC Kconfig descriptions.
osource "/Users/angelostsanaktsidis/code/PQC/zephyr-ws/zephyr/soc/xlnx/zynqmp/Kconfig"
osource "/Users/angelostsanaktsidis/code/PQC/zephyr-ws/zephyr/soc/xlnx/zynq7000/Kconfig"
osource "/Users/angelostsanaktsidis/code/PQC/zephyr-ws/zephyr/soc/xlnx/versalnet/Kconfig"
osource "/Users/angelostsanaktsidis/code/PQC/zephyr-ws/zephyr/soc/xlnx/versal2/Kconfig"
osource "/Users/angelostsanaktsidis/code/PQC/zephyr-ws/zephyr/soc/xlnx/versal/Kconfig"
osource "/Users/angelostsanaktsidis/code/PQC/zephyr-ws/zephyr/soc/xen/Kconfig"
osource "/Users/angelostsanaktsidis/code/PQC/zephyr-ws/zephyr/soc/wch/ch32v/Kconfig"
osource "/Users/angelostsanaktsidis/code/PQC/zephyr-ws/zephyr/soc/ti/simplelink/Kconfig"
osource "/Users/angelostsanaktsidis/code/PQC/zephyr-ws/zephyr/soc/ti/mspm0/Kconfig"
osource "/Users/angelostsanaktsidis/code/PQC/zephyr-ws/zephyr/soc/ti/lm3s6965/Kconfig"
osource "/Users/angelostsanaktsidis/code/PQC/zephyr-ws/zephyr/soc/ti/k3/Kconfig"
osource "/Users/angelostsanaktsidis/code/PQC/zephyr-ws/zephyr/soc/telink/tlsr/Kconfig"
osource "/Users/angelostsanaktsidis/code/PQC/zephyr-ws/zephyr/soc/syna/sr100/Kconfig"
osource "/Users/angelostsanaktsidis/code/PQC/zephyr-ws/zephyr/soc/starfive/jh71xx/Kconfig"
osource "/Users/angelostsanaktsidis/code/PQC/zephyr-ws/zephyr/soc/st/stm32/Kconfig"
osource "/Users/angelostsanaktsidis/code/PQC/zephyr-ws/zephyr/soc/snps/qemu_arc/Kconfig"
osource "/Users/angelostsanaktsidis/code/PQC/zephyr-ws/zephyr/soc/snps/nsim/arc_v/Kconfig"
osource "/Users/angelostsanaktsidis/code/PQC/zephyr-ws/zephyr/soc/snps/nsim/arc_classic/Kconfig"
osource "/Users/angelostsanaktsidis/code/PQC/zephyr-ws/zephyr/soc/snps/hsdk4xd/Kconfig"
osource "/Users/angelostsanaktsidis/code/PQC/zephyr-ws/zephyr/soc/snps/hsdk/Kconfig"
osource "/Users/angelostsanaktsidis/code/PQC/zephyr-ws/zephyr/soc/snps/emsk/Kconfig"
osource "/Users/angelostsanaktsidis/code/PQC/zephyr-ws/zephyr/soc/snps/emsdp/Kconfig"
osource "/Users/angelostsanaktsidis/code/PQC/zephyr-ws/zephyr/soc/snps/arc_iot/Kconfig"
osource "/Users/angelostsanaktsidis/code/PQC/zephyr-ws/zephyr/soc/silabs/Kconfig"
osource "/Users/angelostsanaktsidis/code/PQC/zephyr-ws/zephyr/soc/sifli/sf32/Kconfig"
osource "/Users/angelostsanaktsidis/code/PQC/zephyr-ws/zephyr/soc/sifive/sifive_freedom/Kconfig"
osource "/Users/angelostsanaktsidis/code/PQC/zephyr-ws/zephyr/soc/sensry/Kconfig"
osource "/Users/angelostsanaktsidis/code/PQC/zephyr-ws/zephyr/soc/rockchip/Kconfig"
osource "/Users/angelostsanaktsidis/code/PQC/zephyr-ws/zephyr/soc/renode/riscv_virtual/Kconfig"
osource "/Users/angelostsanaktsidis/code/PQC/zephyr-ws/zephyr/soc/renode/cortex_r8_virtual/Kconfig"
osource "/Users/angelostsanaktsidis/code/PQC/zephyr-ws/zephyr/soc/renesas/smartbond/Kconfig"
osource "/Users/angelostsanaktsidis/code/PQC/zephyr-ws/zephyr/soc/renesas/rz/Kconfig"
osource "/Users/angelostsanaktsidis/code/PQC/zephyr-ws/zephyr/soc/renesas/rx/Kconfig"
osource "/Users/angelostsanaktsidis/code/PQC/zephyr-ws/zephyr/soc/renesas/rcar/Kconfig"
osource "/Users/angelostsanaktsidis/code/PQC/zephyr-ws/zephyr/soc/renesas/ra/Kconfig"
osource "/Users/angelostsanaktsidis/code/PQC/zephyr-ws/zephyr/soc/realtek/fingerprint/Kconfig"
osource "/Users/angelostsanaktsidis/code/PQC/zephyr-ws/zephyr/soc/realtek/ec/Kconfig"
osource "/Users/angelostsanaktsidis/code/PQC/zephyr-ws/zephyr/soc/realtek/bee/Kconfig"
osource "/Users/angelostsanaktsidis/code/PQC/zephyr-ws/zephyr/soc/realtek/ameba/Kconfig"
osource "/Users/angelostsanaktsidis/code/PQC/zephyr-ws/zephyr/soc/raspberrypi/rpi_pico/Kconfig"
osource "/Users/angelostsanaktsidis/code/PQC/zephyr-ws/zephyr/soc/quicklogic/eos_s3/Kconfig"
osource "/Users/angelostsanaktsidis/code/PQC/zephyr-ws/zephyr/soc/qemu/virt_riscv/Kconfig"
osource "/Users/angelostsanaktsidis/code/PQC/zephyr-ws/zephyr/soc/qemu/or1k/Kconfig"
osource "/Users/angelostsanaktsidis/code/PQC/zephyr-ws/zephyr/soc/qemu/malta/Kconfig"
osource "/Users/angelostsanaktsidis/code/PQC/zephyr-ws/zephyr/soc/openisa/rv32m1/Kconfig"
osource "/Users/angelostsanaktsidis/code/PQC/zephyr-ws/zephyr/soc/openhwgroup/cva6/Kconfig"
osource "/Users/angelostsanaktsidis/code/PQC/zephyr-ws/zephyr/soc/oct/osd32mp15x/Kconfig"
osource "/Users/angelostsanaktsidis/code/PQC/zephyr-ws/zephyr/soc/nxp/s32/Kconfig"
osource "/Users/angelostsanaktsidis/code/PQC/zephyr-ws/zephyr/soc/nxp/rw/Kconfig"
osource "/Users/angelostsanaktsidis/code/PQC/zephyr-ws/zephyr/soc/nxp/mcx/Kconfig"
osource "/Users/angelostsanaktsidis/code/PQC/zephyr-ws/zephyr/soc/nxp/lpc/Kconfig"
osource "/Users/angelostsanaktsidis/code/PQC/zephyr-ws/zephyr/soc/nxp/layerscape/Kconfig"
osource "/Users/angelostsanaktsidis/code/PQC/zephyr-ws/zephyr/soc/nxp/kinetis/Kconfig"
osource "/Users/angelostsanaktsidis/code/PQC/zephyr-ws/zephyr/soc/nxp/imxrt/Kconfig"
osource "/Users/angelostsanaktsidis/code/PQC/zephyr-ws/zephyr/soc/nxp/imx/Kconfig"
osource "/Users/angelostsanaktsidis/code/PQC/zephyr-ws/zephyr/soc/nuvoton/numicro/Kconfig"
osource "/Users/angelostsanaktsidis/code/PQC/zephyr-ws/zephyr/soc/nuvoton/numaker/Kconfig"
osource "/Users/angelostsanaktsidis/code/PQC/zephyr-ws/zephyr/soc/nuvoton/npcx/Kconfig"
osource "/Users/angelostsanaktsidis/code/PQC/zephyr-ws/zephyr/soc/nuvoton/npcm/Kconfig"
osource "/Users/angelostsanaktsidis/code/PQC/zephyr-ws/zephyr/soc/nordic/Kconfig"
osource "/Users/angelostsanaktsidis/code/PQC/zephyr-ws/zephyr/soc/neorv32/Kconfig"
osource "/Users/angelostsanaktsidis/code/PQC/zephyr-ws/zephyr/soc/native/inf_clock/Kconfig"
osource "/Users/angelostsanaktsidis/code/PQC/zephyr-ws/zephyr/soc/microchip/sam/sama7/Kconfig"
osource "/Users/angelostsanaktsidis/code/PQC/zephyr-ws/zephyr/soc/microchip/sam/sam_d5x_e5x/Kconfig"
osource "/Users/angelostsanaktsidis/code/PQC/zephyr-ws/zephyr/soc/microchip/pic64/Kconfig"
osource "/Users/angelostsanaktsidis/code/PQC/zephyr-ws/zephyr/soc/microchip/pic32c/pic32cz_ca/Kconfig"
osource "/Users/angelostsanaktsidis/code/PQC/zephyr-ws/zephyr/soc/microchip/pic32c/pic32cx_sg/Kconfig"
osource "/Users/angelostsanaktsidis/code/PQC/zephyr-ws/zephyr/soc/microchip/pic32c/pic32cm_pl/Kconfig"
osource "/Users/angelostsanaktsidis/code/PQC/zephyr-ws/zephyr/soc/microchip/pic32c/pic32cm_jh/Kconfig"
osource "/Users/angelostsanaktsidis/code/PQC/zephyr-ws/zephyr/soc/microchip/miv/Kconfig"
osource "/Users/angelostsanaktsidis/code/PQC/zephyr-ws/zephyr/soc/microchip/mec/Kconfig"
osource "/Users/angelostsanaktsidis/code/PQC/zephyr-ws/zephyr/soc/mediatek/mt8xxx/Kconfig"
osource "/Users/angelostsanaktsidis/code/PQC/zephyr-ws/zephyr/soc/lowrisc/opentitan/Kconfig"
osource "/Users/angelostsanaktsidis/code/PQC/zephyr-ws/zephyr/soc/litex/litex_vexriscv/Kconfig"
osource "/Users/angelostsanaktsidis/code/PQC/zephyr-ws/zephyr/soc/ite/ec/Kconfig"
osource "/Users/angelostsanaktsidis/code/PQC/zephyr-ws/zephyr/soc/intel/wildcat_lake/Kconfig"
osource "/Users/angelostsanaktsidis/code/PQC/zephyr-ws/zephyr/soc/intel/raptor_lake/Kconfig"
osource "/Users/angelostsanaktsidis/code/PQC/zephyr-ws/zephyr/soc/intel/panther_lake/Kconfig"
osource "/Users/angelostsanaktsidis/code/PQC/zephyr-ws/zephyr/soc/intel/lakemont/Kconfig"
osource "/Users/angelostsanaktsidis/code/PQC/zephyr-ws/zephyr/soc/intel/intel_socfpga_std/Kconfig"
osource "/Users/angelostsanaktsidis/code/PQC/zephyr-ws/zephyr/soc/intel/intel_socfpga/Kconfig"
osource "/Users/angelostsanaktsidis/code/PQC/zephyr-ws/zephyr/soc/intel/intel_niosv/Kconfig"
osource "/Users/angelostsanaktsidis/code/PQC/zephyr-ws/zephyr/soc/intel/intel_ish/Kconfig"
osource "/Users/angelostsanaktsidis/code/PQC/zephyr-ws/zephyr/soc/intel/intel_adsp/Kconfig"
osource "/Users/angelostsanaktsidis/code/PQC/zephyr-ws/zephyr/soc/intel/elkhart_lake/Kconfig"
osource "/Users/angelostsanaktsidis/code/PQC/zephyr-ws/zephyr/soc/intel/atom/Kconfig"
osource "/Users/angelostsanaktsidis/code/PQC/zephyr-ws/zephyr/soc/intel/apollo_lake/Kconfig"
osource "/Users/angelostsanaktsidis/code/PQC/zephyr-ws/zephyr/soc/intel/alder_lake/Kconfig"
osource "/Users/angelostsanaktsidis/code/PQC/zephyr-ws/zephyr/soc/infineon/psoc4/Kconfig"
osource "/Users/angelostsanaktsidis/code/PQC/zephyr-ws/zephyr/soc/infineon/edge/Kconfig"
osource "/Users/angelostsanaktsidis/code/PQC/zephyr-ws/zephyr/soc/infineon/cat3/Kconfig"
osource "/Users/angelostsanaktsidis/code/PQC/zephyr-ws/zephyr/soc/infineon/cat1c/Kconfig"
osource "/Users/angelostsanaktsidis/code/PQC/zephyr-ws/zephyr/soc/infineon/cat1b/Kconfig"
osource "/Users/angelostsanaktsidis/code/PQC/zephyr-ws/zephyr/soc/infineon/cat1a/Kconfig"
osource "/Users/angelostsanaktsidis/code/PQC/zephyr-ws/zephyr/soc/gd/gd32/Kconfig"
osource "/Users/angelostsanaktsidis/code/PQC/zephyr-ws/zephyr/soc/gaisler/leon3/Kconfig"
osource "/Users/angelostsanaktsidis/code/PQC/zephyr-ws/zephyr/soc/gaisler/gr716a/Kconfig"
osource "/Users/angelostsanaktsidis/code/PQC/zephyr-ws/zephyr/soc/focaltech/Kconfig"
osource "/Users/angelostsanaktsidis/code/PQC/zephyr-ws/zephyr/soc/espressif/Kconfig"
osource "/Users/angelostsanaktsidis/code/PQC/zephyr-ws/zephyr/soc/ene/kb1200/Kconfig"
osource "/Users/angelostsanaktsidis/code/PQC/zephyr-ws/zephyr/soc/ene/kb106x/Kconfig"
osource "/Users/angelostsanaktsidis/code/PQC/zephyr-ws/zephyr/soc/elan/em32f967/Kconfig"
osource "/Users/angelostsanaktsidis/code/PQC/zephyr-ws/zephyr/soc/egis/Kconfig"
osource "/Users/angelostsanaktsidis/code/PQC/zephyr-ws/zephyr/soc/efinix/sapphire/Kconfig"
osource "/Users/angelostsanaktsidis/code/PQC/zephyr-ws/zephyr/soc/cdns/xtensa_sample_controller/Kconfig"
osource "/Users/angelostsanaktsidis/code/PQC/zephyr-ws/zephyr/soc/cdns/swerv/Kconfig"
osource "/Users/angelostsanaktsidis/code/PQC/zephyr-ws/zephyr/soc/cdns/sample_controller32/Kconfig"
osource "/Users/angelostsanaktsidis/code/PQC/zephyr-ws/zephyr/soc/cdns/dc233c/Kconfig"
osource "/Users/angelostsanaktsidis/code/PQC/zephyr-ws/zephyr/soc/brcm/bcmvk/Kconfig"
osource "/Users/angelostsanaktsidis/code/PQC/zephyr-ws/zephyr/soc/brcm/bcm2712/Kconfig"
osource "/Users/angelostsanaktsidis/code/PQC/zephyr-ws/zephyr/soc/brcm/bcm2711/Kconfig"
osource "/Users/angelostsanaktsidis/code/PQC/zephyr-ws/zephyr/soc/blackberry/qnxhv_vm/Kconfig"
osource "/Users/angelostsanaktsidis/code/PQC/zephyr-ws/zephyr/soc/bflb/Kconfig"
osource "/Users/angelostsanaktsidis/code/PQC/zephyr-ws/zephyr/soc/atmel/sam0/Kconfig"
osource "/Users/angelostsanaktsidis/code/PQC/zephyr-ws/zephyr/soc/atmel/sam/Kconfig"
osource "/Users/angelostsanaktsidis/code/PQC/zephyr-ws/zephyr/soc/aspeed/Kconfig"
osource "/Users/angelostsanaktsidis/code/PQC/zephyr-ws/zephyr/soc/arm/Kconfig"
osource "/Users/angelostsanaktsidis/code/PQC/zephyr-ws/zephyr/soc/arm/beetle/Kconfig"
osource "/Users/angelostsanaktsidis/code/PQC/zephyr-ws/zephyr/soc/antmicro/myra/Kconfig"
osource "/Users/angelostsanaktsidis/code/PQC/zephyr-ws/zephyr/soc/andestech/Kconfig"
osource "/Users/angelostsanaktsidis/code/PQC/zephyr-ws/zephyr/soc/amd/acp_6_0/Kconfig"
osource "/Users/angelostsanaktsidis/code/PQC/zephyr-ws/zephyr/soc/ambiq/Kconfig"
osource "/Users/angelostsanaktsidis/code/PQC/zephyr-ws/zephyr/soc/allwinner/sun8i_h3/Kconfig"
osource "/Users/angelostsanaktsidis/code/PQC/zephyr-ws/zephyr/soc/alif/ensemble/Kconfig"
osource "/Users/angelostsanaktsidis/code/PQC/zephyr-ws/zephyr/soc/aesc/Kconfig"
osource "/Users/angelostsanaktsidis/code/PQC/zephyr-ws/zephyr/soc/adi/max32/Kconfig"
```

## tests/ztest_acvp_kat/testcase.yaml
```yaml
tests:
  pqcp.acvp_kat.smoke:
    tags:
      - pqcp
      - acvp
      - kat
    harness: ztest
    platform_allow:
      - qemu_x86_64
    integration_platforms:
      - qemu_x86_64
    timeout: 300
```

## tests/ztest_adaptive_control/testcase.yaml
```yaml
# SPDX-License-Identifier: MIT
tests:
  pqcp.adaptive_control:
    tags:
      - pqcp
      - adaptive
    harness: ztest
    platform_allow:
      - qemu_x86_64
    integration_platforms:
      - qemu_x86_64
    timeout: 120
```

## tests/ztest_assurance_status/testcase.yaml
```yaml
# SPDX-License-Identifier: MIT
tests:
  pqcp.assurance_status:
    tags:
      - pqcp
      - assurance
    harness: ztest
    platform_allow:
      - qemu_x86_64
    integration_platforms:
      - qemu_x86_64
    timeout: 120
```

## tests/ztest_capability_descriptor/testcase.yaml
```yaml
# SPDX-License-Identifier: LicenseRef-Proprietary-Collaborative-Evaluation
tests:
  pqcp.capability_descriptor:
    tags:
      - pqcp
      - capability
    harness: ztest
    platform_allow:
      - qemu_x86_64
    integration_platforms:
      - qemu_x86_64
    timeout: 120
```

## tests/ztest_capability_extension/testcase.yaml
```yaml
tests:
  pqcp.capability_extension:
    tags: [pqcp, capability, evidence]
    harness: ztest
    platform_allow: [qemu_x86_64]
    integration_platforms: [qemu_x86_64]
    timeout: 120
```

## tests/ztest_ct_trace/testcase.yaml
```yaml
# SPDX-License-Identifier: LicenseRef-Proprietary-Collaborative-Evaluation
tests:
  pqcp.ct_trace:
    tags:
      - pqcp
      - ct
      - crypto
    harness: ztest
    platform_allow:
      - qemu_x86_64
    integration_platforms:
      - qemu_x86_64
    timeout: 300
```

## tests/ztest_deployment_assurance_passport_replay/testcase.yaml
```yaml
# SPDX-License-Identifier: MIT
tests:
  pqcp.deployment_assurance_passport_replay:
    tags:
      - pqcp
      - deployment
      - evidence
    harness: ztest
    platform_allow:
      - qemu_x86_64
    integration_platforms:
      - qemu_x86_64
    timeout: 120
```

## tests/ztest_deployment_device_packet/testcase.yaml
```yaml
# SPDX-License-Identifier: LicenseRef-Proprietary-Collaborative-Evaluation
tests:
  pqcp.deployment_device_packet:
    tags:
      - pqcp
      - deployment
      - evidence
    harness: ztest
    platform_allow:
      - qemu_x86_64
    integration_platforms:
      - qemu_x86_64
    timeout: 120
```

## tests/ztest_deployment_evidence_trail/testcase.yaml
```yaml
tests:
  pqcp.deployment.evidence_trail:
    tags: [pqcp, deployment, evidence]
    harness: ztest
    platform_allow: [qemu_x86_64]
    integration_platforms: [qemu_x86_64]
    timeout: 180
```

## tests/ztest_deployment_evidence_trail_replay/testcase.yaml
```yaml
tests:
  pqcp.deployment.evidence_trail_replay:
    tags: [pqcp, deployment, evidence, replay]
    harness: ztest
    platform_allow: [qemu_x86_64]
    integration_platforms: [qemu_x86_64]
    timeout: 180
```
