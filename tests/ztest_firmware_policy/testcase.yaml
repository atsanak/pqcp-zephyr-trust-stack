## tests/ztest_firmware_policy/testcase.yaml
```yaml
# SPDX-License-Identifier: MIT
tests:
  pqcp.firmware_policy:
    tags:
      - pqcp
      - firmware
    harness: ztest
    platform_allow:
      - qemu_x86_64
    integration_platforms:
      - qemu_x86_64
    timeout: 120
```

## tests/ztest_firmware_scorecard/testcase.yaml
```yaml
# SPDX-License-Identifier: MIT
tests:
  pqcp.firmware_scorecard:
    tags:
      - pqcp
      - firmware
    harness: ztest
    platform_allow:
      - qemu_x86_64
    integration_platforms:
      - qemu_x86_64
    timeout: 120
```

## tests/ztest_fleet_artifact_core/testcase.yaml
```yaml
# SPDX-License-Identifier: MIT
tests:
  pqcp.fleet_artifact_core:
    tags:
      - pqcp
      - fleet
      - crypto
    harness: ztest
    platform_allow:
      - qemu_x86_64
    integration_platforms:
      - qemu_x86_64
    timeout: 300
```

## tests/ztest_pqcp_channel/testcase.yaml
```yaml
# SPDX-License-Identifier: MIT

tests:
  pqcp.channel:
    platform_allow:
      - qemu_x86_64
    tags:
      - pqcp
      - channel
      - crypto
```

## tests/ztest_pqcp_fleet_trust/testcase.yaml
```yaml
tests:
  pqcp.fleet_trust:
    platform_allow:
      - qemu_x86_64
    tags:
      - pqcp
      - fleet
      - protocol
      - storage
    timeout: 240
```

## tests/ztest_pqcp_operations/testcase.yaml
```yaml
# SPDX-License-Identifier: MIT

tests:
  pqcp.operations:
    platform_allow:
      - qemu_x86_64
    tags:
      - pqcp
      - runtime
      - channel
      - operations
    timeout: 120
```

## tests/ztest_pqcp_recovery/testcase.yaml
```yaml
# SPDX-License-Identifier: MIT
tests:
  pqcp.recovery:
    platform_allow:
      - qemu_x86_64
    tags:
      - pqcp
      - runtime
      - flash
    timeout: 120
```

## tests/ztest_pqcp_runtime/testcase.yaml
```yaml
# SPDX-License-Identifier: MIT

tests:
  pqcp.runtime:
    platform_allow:
      - qemu_x86_64
    tags:
      - pqcp
      - runtime
      - crypto
  pqcp.runtime.all_levels:
    platform_allow:
      - qemu_x86_64
    extra_conf_files:
      - overlay-all-levels.conf
    tags:
      - pqcp
      - runtime
      - crypto
      - multi-level
    timeout: 240
```

## tests/ztest_pqcp_runtime_psa_provider/testcase.yaml
```yaml
tests:
  pqcp.runtime.psa_provider:
    platform_allow:
      - qemu_x86_64
    tags:
      - pqcp
      - runtime
      - psa
    timeout: 120
```

## tests/ztest_pqcp_tls_loopback/testcase.yaml
```yaml
tests:
  pqcp.tls_loopback:
    platform_allow:
      - qemu_x86_64
    tags:
      - pqcp
      - tls
      - mbedtls
      - protected-channel
    timeout: 180
  pqcp.tls_loopback.tcp:
    platform_allow:
      - qemu_x86_64
    tags:
      - pqcp
      - tls
      - tcp
      - protected-channel
    extra_conf_files:
      - tcp.conf
    timeout: 180
```

## tests/ztest_provider_contract/testcase.yaml
```yaml
# SPDX-License-Identifier: MIT
tests:
  pqcp.provider_contract:
    tags:
      - pqcp
      - provider
    harness: ztest
    platform_allow:
      - qemu_x86_64
    integration_platforms:
      - qemu_x86_64
    timeout: 120
```

## tests/ztest_sha3_crosscheck/testcase.yaml
```yaml
# SPDX-License-Identifier: MIT
tests:
  pqcp.sha3_crosscheck:
    tags:
      - pqcp
      - crypto
    harness: ztest
    platform_allow:
      - qemu_x86_64
    integration_platforms:
      - qemu_x86_64
    timeout: 300
```

## tests/ztest_sovereign_audit/testcase.yaml
```yaml
tests:
  pqcp.sovereign_audit:
    harness: ztest
    platform_allow:
      - qemu_x86_64
    integration_platforms:
      - qemu_x86_64
    tags:
      - pqcp
      - sovereign
      - evidence
    timeout: 300
```

## tests/ztest_sovereign_policy/testcase.yaml
```yaml
tests:
  pqcp.sovereign_policy:
    harness: ztest
    platform_allow:
      - qemu_x86_64
    integration_platforms:
      - qemu_x86_64
    tags:
      - pqcp
      - sovereign
    timeout: 300
```

## west.yml
```yaml
manifest:
  self:
    path: pqcp-zephyr-trust-stack

  remotes:
    - name: zephyrproject-rtos
      url-base: https://github.com/zephyrproject-rtos
    - name: pqcp
      url-base: https://github.com/pq-code-package

  defaults:
    remote: zephyrproject-rtos

  projects:
    - name: zephyr
      remote: zephyrproject-rtos
      revision: 3568e1b6d5cdd51a6b964a2a1d6d29200fea2056
      import: true
    - name: mlkem-native
      remote: pqcp
      revision: e07bff537f38b457601e524038f2395e235b011b
      path: modules/crypto/mlkem-native
    - name: mldsa-native
      remote: pqcp
      revision: 0f8b8e074b2525eb844b022b03b962bf888d51aa
      path: modules/crypto/mldsa-native
```
