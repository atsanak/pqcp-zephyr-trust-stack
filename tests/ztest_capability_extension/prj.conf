## CMakeLists.txt
```
# SPDX-License-Identifier: MIT

cmake_minimum_required(VERSION 3.20.0)

set(PQCP_LOCAL_MODULE_ROOT "${CMAKE_CURRENT_LIST_DIR}/../..")
include(${PQCP_LOCAL_MODULE_ROOT}/cmake/pqcp_local_module.cmake)

find_package(Zephyr REQUIRED HINTS $ENV{ZEPHYR_BASE})
project(pqcp_ztest_capability_extension)

target_sources(app PRIVATE src/main.c)
```

## prj.conf
```kconfig
# SPDX-License-Identifier: MIT

CONFIG_ZTEST=y
CONFIG_PRINTK=y
CONFIG_PQCP=y
CONFIG_PQCP_MLKEM=n
CONFIG_PQCP_MLDSA=n
CONFIG_PQCP_RNG_CUSTOM=y

CONFIG_PQCP_PROVIDER_CONTRACT=y
CONFIG_PQCP_BUILD_MANIFEST=y
CONFIG_PQCP_FIRMWARE_POLICY=y
CONFIG_PQCP_CAPABILITY_DESCRIPTOR=y
CONFIG_PQCP_DEPLOYMENT_ADVISOR=y
CONFIG_PQCP_DEPLOYMENT_ROBUSTNESS=y
CONFIG_PQCP_DEPLOYMENT_CAMPAIGN=y
CONFIG_PQCP_DEPLOYMENT_TRANSCRIPT=y
CONFIG_PQCP_DEPLOYMENT_APPRAISAL=y
CONFIG_PQCP_DEPLOYMENT_CLAIMS=y
CONFIG_PQCP_DEPLOYMENT_TRACE_BUILDER=y
CONFIG_PQCP_DEPLOYMENT_PIPELINE=y
CONFIG_PQCP_DEPLOYMENT_BUDGET=y
CONFIG_PQCP_DEPLOYMENT_EXPERIMENT_PLAN=y
CONFIG_PQCP_DEPLOYMENT_REVIEW_PACKET=y
CONFIG_PQCP_DEPLOYMENT_REVIEW_VERIFIER=y
CONFIG_PQCP_DEPLOYMENT_REVIEW_AUDIT=y
CONFIG_PQCP_DEPLOYMENT_RELEASE_GATE=y
CONFIG_PQCP_DEPLOYMENT_DEVICE_TOKEN=y
CONFIG_PQCP_DEPLOYMENT_DEVICE_TOKEN_REPLAY=y
CONFIG_PQCP_DEPLOYMENT_DEVICE_TOKEN_AUDIT=y
CONFIG_PQCP_DEPLOYMENT_DEVICE_GATE=y
CONFIG_PQCP_DEPLOYMENT_DEVICE_PACKET=y
CONFIG_PQCP_DEPLOYMENT_DEVICE_PACKET_REPLAY=y
CONFIG_PQCP_DEPLOYMENT_DEVICE_PACKET_AUDIT=y
CONFIG_PQCP_DEPLOYMENT_EVIDENCE_VERDICT=y
CONFIG_PQCP_DEPLOYMENT_EVIDENCE_VERDICT_REPLAY=y
CONFIG_PQCP_DEPLOYMENT_EVIDENCE_VERDICT_AUDIT=y
CONFIG_PQCP_DEPLOYMENT_EVIDENCE_SEAL=y
CONFIG_PQCP_DEPLOYMENT_EVIDENCE_SEAL_REPLAY=y
CONFIG_PQCP_DEPLOYMENT_EVIDENCE_SEAL_AUDIT=y
CONFIG_PQCP_DEPLOYMENT_ASSURANCE_PASSPORT=y
CONFIG_PQCP_DEPLOYMENT_ASSURANCE_PASSPORT_REPLAY=y
CONFIG_PQCP_CAPABILITY_EXTENSION=y
CONFIG_PQCP_DEPLOYMENT_TAMPER_ENGINE=y

CONFIG_MAIN_STACK_SIZE=8192
CONFIG_ZTEST_STACK_SIZE=16384
```

## src/main.c
```c
/*
 * SPDX-License-Identifier: MIT
 *
 * Tests for the extended firmware capability plane.
 */

#include <errno.h>
#include <string.h>

#include <zephyr/ztest.h>

#include <pqcp_zephyr/capability_extension.h>

ZTEST(pqcp_capability_extension, test_current_reflects_compiled_modules)
{
	uint32_t ext = pqcp_capability_evidence_ext_current();

	/* This image enables exactly the extension plane itself and the
	 * tamper engine; every other extended module is compiled out.
	 */
	zassert_true((ext & PQCP_CAPABILITY_EXT_CAPABILITY_EXTENSION) != 0U);
	zassert_true((ext & PQCP_CAPABILITY_EXT_TAMPER_ENGINE) != 0U);
	zassert_equal(ext & ~(PQCP_CAPABILITY_EXT_CAPABILITY_EXTENSION |
			      PQCP_CAPABILITY_EXT_TAMPER_ENGINE),
		      0U);
	zassert_equal(ext & ~PQCP_CAPABILITY_EXT_KNOWN_MASK, 0U);
}

ZTEST(pqcp_capability_extension, test_current_summary_binds_base_word)
{
	struct pqcp_capability_extension extension;

	zassert_equal(pqcp_capability_extension_current(&extension), 0);
	zassert_equal(extension.schema_version,
		      PQCP_CAPABILITY_EXTENSION_SCHEMA_VERSION);
	zassert_equal(extension.base_capabilities,
		      pqcp_capability_evidence_capabilities_current());
	zassert_equal(extension.ext_capabilities,
		      pqcp_capability_evidence_ext_current());
	zassert_equal(extension.ext_known_mask,
		      PQCP_CAPABILITY_EXT_KNOWN_MASK);
	zassert_equal(extension.ext_count, 2U);
	/* This image compiles only part of the base evidence stack. */
	zassert_equal(extension.base_full,
		      (extension.base_capabilities &
		       PQCP_CAPABILITY_EVIDENCE_KNOWN_MASK) ==
			      PQCP_CAPABILITY_EVIDENCE_KNOWN_MASK);

	zassert_equal(pqcp_capability_extension_current(NULL), -EINVAL);
}

ZTEST(pqcp_capability_extension, test_emit_accepts_genuine_summary)
{
	struct pqcp_capability_extension extension;

	zassert_equal(pqcp_capability_extension_current(&extension), 0);
	zassert_equal(pqcp_capability_extension_emit(&extension), 0);
}

ZTEST(pqcp_capability_extension, test_emit_rejects_tampered_summary)
{
	struct pqcp_capability_extension extension;

	zassert_equal(pqcp_capability_extension_emit(NULL), -EINVAL);

	zassert_equal(pqcp_capability_extension_current(&extension), 0);
	extension.schema_version = 99U;
	zassert_equal(pqcp_capability_extension_emit(&extension), -EINVAL);

	zassert_equal(pqcp_capability_extension_current(&extension), 0);
	extension.ext_capabilities |= 0x80000000U;
	zassert_equal(pqcp_capability_extension_emit(&extension), -EINVAL);

	zassert_equal(pqcp_capability_extension_current(&extension), 0);
	extension.ext_known_mask = 0xffffffffU;
	zassert_equal(pqcp_capability_extension_emit(&extension), -EINVAL);

	zassert_equal(pqcp_capability_extension_current(&extension), 0);
	extension.ext_count = 33U;
	zassert_equal(pqcp_capability_extension_emit(&extension), -EINVAL);
}

ZTEST_SUITE(pqcp_capability_extension, NULL, NULL, NULL, NULL, NULL);
```
