## CMakeLists.txt
```
# SPDX-License-Identifier: MIT

cmake_minimum_required(VERSION 3.20.0)

set(PQCP_LOCAL_MODULE_ROOT "${CMAKE_CURRENT_LIST_DIR}/../..")
include(${PQCP_LOCAL_MODULE_ROOT}/cmake/pqcp_local_module.cmake)

find_package(Zephyr REQUIRED HINTS $ENV{ZEPHYR_BASE})
project(ztest_edge_model)

# test_common.h (principal/digest fixtures, T0, CAP_ALL) is shared with the
# edge security suite, so the two suites move together.
target_include_directories(app PRIVATE
    ${PQCP_LOCAL_MODULE_ROOT}/src/internal
    ${PQCP_LOCAL_MODULE_ROOT}/tests/ztest_edge_security/src
    ${CMAKE_CURRENT_LIST_DIR}/src)
target_sources(app PRIVATE
    src/main.c
    src/model_harness.c
    src/model_credential.c
    src/model_policy.c
    src/model_principal.c
    src/model_session.c
    src/test_harness.c)
```

## prj.conf
```kconfig
# SPDX-License-Identifier: MIT

CONFIG_ZTEST=y
CONFIG_PRINTK=y
CONFIG_PQCP=y
CONFIG_PQCP_MLKEM=y
CONFIG_PQCP_MLKEM_LEVEL_768=y
CONFIG_PQCP_MLDSA=y
CONFIG_PQCP_MLDSA_LEVEL_65=y
CONFIG_ENTROPY_GENERATOR=y
CONFIG_PQCP_RNG_ZEPHYR_ENTROPY=y
CONFIG_PSA_CRYPTO=y
CONFIG_MBEDTLS=y
CONFIG_MBEDTLS_PSA_CRYPTO_C=y
CONFIG_PQCP_DEPLOYMENT_ADVISOR=y
CONFIG_PQCP_DEPLOYMENT_EVIDENCE_CODEC=y
CONFIG_PQCP_ADAPTIVE_CONTROL=y
CONFIG_PQCP_RUNTIME=y
CONFIG_PQCP_RUNTIME_KEY_STORE_VOLATILE=y
CONFIG_PQCP_PROTECTED_CHANNEL=y
CONFIG_PQCP_FLEET_TRUST=y
CONFIG_PQCP_EDGE_SECURITY=y

CONFIG_MAIN_STACK_SIZE=131072
CONFIG_ZTEST_STACK_SIZE=131072
CONFIG_THREAD_STACK_INFO=y
CONFIG_INIT_STACKS=y
```

## src/main.c
```c
/*
 * SPDX-License-Identifier: MIT
 *
 * Suite entry point: one test per modelled module plus the harness
 * controls. The suite teardown prints the final PQCP_MODEL_SUMMARY marker
 * once every module has run, whether or not it conformed.
 */

#include <psa/crypto.h>

#include <zephyr/sys/printk.h>

#include "model_modules.h"
#include "test_common.h"

struct model_totals {
	uint32_t modules;
	uint32_t traces;
	uint32_t ops;
	uint32_t violations;
};

static struct model_totals totals;

static void *suite_setup(void)
{
	zassert_equal(psa_crypto_init(), PSA_SUCCESS);
	return NULL;
}

static void suite_teardown(void *fixture)
{
	ARG_UNUSED(fixture);
	if (totals.modules != MODEL_MODULE_COUNT) {
		return;
	}
	printk("PQCP_MODEL_SUMMARY modules=%u traces=%u ops=%u "
	       "violations=%u status=%s\n",
	       totals.modules, totals.traces, totals.ops,
	       totals.violations,
	       totals.violations == 0U ? "PASS" : "FAIL");
}

ZTEST_SUITE(edge_model, NULL, suite_setup, NULL, NULL, suite_teardown);

/*
 * Run one module for MODEL_SEEDS traces, fail the case on any violation,
 * and require a second run to be bit-for-bit identical (determinism: the
 * same seeds drive the same traces to the same outcome).
 */
void model_run_module(const struct model_vtable *vt, uint32_t index)
{
	struct model_stats first;
	struct model_stats second;
	uint32_t violations;

	violations = model_check(vt, index, MODEL_SEEDS, true, &first);
	++totals.modules;
	totals.traces += first.seeds;
	totals.ops += first.ops;
	totals.violations += violations;
	zassert_equal(violations, 0U,
		      "model %s: %u violating trace(s)", vt->name,
		      violations);
	zassert_equal(model_check(vt, index, MODEL_SEEDS, false, &second),
		      0U);
	zassert_equal(second.ops, first.ops);
}

ZTEST(edge_model, test_principal_model)
{
	model_run_module(&model_principal_vt, MODEL_INDEX_PRINCIPAL);
}

ZTEST(edge_model, test_session_model)
{
	model_run_module(&model_session_vt, MODEL_INDEX_SESSION);
}

ZTEST(edge_model, test_credential_model)
{
	model_run_module(&model_credential_vt, MODEL_INDEX_CREDENTIAL);
}

ZTEST(edge_model, test_policy_model)
{
	model_run_module(&model_policy_vt, MODEL_INDEX_POLICY);
}
```

## src/model_credential.c
```c
/*
 * SPDX-License-Identifier: MIT
 *
 * Abstract model of the credential cache's revocation semantics
 * (edge_credential_cache.c). The model is one set: ids that were
 * successfully revoked. Revocation is terminal: nothing that happens
 * afterwards (more puts, expiry ticks, time passing, slot pressure from
 * other credentials) may make a revoked id usable again.
 *
 * Properties (violation codes):
 *   41 C1  authorize never succeeds for a revoked id
 *   42 C2  put over a revoked id never succeeds
 *   43 C3  a put of a different id never evicts revocation state: the
 *          revoked id still fails authorize and put afterwards (checked by
 *          C1/C2 on later ops, so slot reuse of revoked records is caught)
 *   44     an op returned something other than the specified result
 */

#include "model_modules.h"
#include "test_common.h"

#define CAPACITY 2U
#define IDS 3U

enum { C_AUTH = 41, C_PUT = 42, C_RESULT = 44 };

enum { OP_PUT, OP_REVOKE, OP_AUTH, OP_TICK, OP_WAIT };

static const uint8_t op_of[] = {
	OP_PUT, OP_PUT, OP_PUT, OP_REVOKE, OP_REVOKE,
	OP_AUTH, OP_AUTH, OP_TICK, OP_WAIT,
};

static const char *const cids[IDS] = { "c0", "c1", "c2" };

static struct pqcp_edge_credential_record store[CAPACITY];
static struct pqcp_edge_credential_cache cache;
static bool revoked[IDS];
static uint32_t revoked_count;
static uint64_t repoch;
static uint64_t epoch;
static uint64_t now;

static void reset(void)
{
	memset(revoked, 0, sizeof(revoked));
	revoked_count = 0U;
	repoch = 1U;
	epoch = 1U;
	now = T0;
	zassert_equal(pqcp_edge_credential_cache_init(
		&cache, store, ARRAY_SIZE(store)), 0);
}

static int audit(void)
{
	return pqcp_edge_credential_cache_audit(&cache);
}

static void fill(struct pqcp_edge_credential_record *c, uint32_t i)
{
	memset(c, 0, sizeof(*c));
	SETSTR(c->credential_id, cids[i]);
	SETSTR(c->principal_id, "p1");
	SETSTR(c->issuer_domain, "dom-a");
	c->issuance_epoch = epoch;
	c->policy_epoch = 2U;
	c->revocation_epoch = repoch;
	c->issued_at_ms = now;
	c->refresh_at_ms = now + 500U;
	c->expires_at_ms = now + 1000U;
	c->capabilities = 0x3U;
	edge_digest(c->public_key_digest, 0x11U);
	edge_digest(c->credential_digest, 0x12U);
}

static int apply(const struct model_op *op)
{
	const uint32_t i = op->a % IDS;

	now += op->dt % 700U;
	switch (op_of[op->kind % ARRAY_SIZE(op_of)]) {
	case OP_PUT: {
		struct pqcp_edge_credential_record c;
		int rc;

		++epoch;
		fill(&c, i);
		rc = pqcp_edge_credential_put(&cache, &c, now);
		if (revoked[i]) {
			MODEL_REQUIRE(rc != 0, C_PUT);
		} else if (revoked_count >= CAPACITY) {
			/* C3: every slot holds a tombstone; none is recycled. */
			MODEL_REQUIRE(rc != 0, C_PUT);
		}
		break;
	}
	case OP_REVOKE:
		/* Revocation needs an epoch newer than the record's; later
		 * puts carry the current epoch, so a put over a revoked id is
		 * rejected by revocation itself and not by staleness.
		 */
		++repoch;
		if (pqcp_edge_credential_revoke(&cache, cids[i], repoch) == 0 &&
		    !revoked[i]) {
			revoked[i] = true;
			++revoked_count;
		}
		break;
	case OP_AUTH: {
		int rc = pqcp_edge_credential_authorize(
			&cache, cids[i], "p1", 0x1U, 2U, 1U, now);

		if (revoked[i]) {
			MODEL_REQUIRE(rc != 0, C_AUTH);
		}
		break;
	}
	case OP_TICK: {
		uint32_t changed = 0U;

		MODEL_REQUIRE(pqcp_edge_credential_tick(&cache, now,
							&changed) == 0,
			      C_RESULT);
		break;
	}
	default:
		break;
	}
	/* A revoked id must stay refused even after unrelated activity. */
	for (uint32_t k = 0U; k < IDS; ++k) {
		if (revoked[k]) {
			MODEL_REQUIRE(pqcp_edge_credential_authorize(
				&cache, cids[k], "p1", 0x1U, 2U, 1U, now) != 0,
				C_AUTH);
		}
	}
	return 0;
}

const struct model_vtable model_credential_vt = {
	.name = "credential",
	.op_kinds = ARRAY_SIZE(op_of),
	.reset = reset,
	.apply = apply,
	.audit = audit,
};
```

## src/model_harness.c
```c
/*
 * SPDX-License-Identifier: MIT
 *
 * Seeded trace generation, replay, delta-debugging shrinker and marker
 * output for the edge model checks. See model_harness.h for the grammar.
 */

#include <string.h>

#include <zephyr/sys/printk.h>

#include "model_harness.h"

const char *model_fail_check = "";
int model_fail_line;

#define MODEL_SEED_BASE 0x5051435046454D31ULL

static uint64_t splitmix64(uint64_t x)
{
	x += 0x9E3779B97F4A7C15ULL;
	x = (x ^ (x >> 30)) * 0xBF58476D1CE4E5B9ULL;
	x = (x ^ (x >> 27)) * 0x94D049BB133111EBULL;
	return x ^ (x >> 31);
}

/* xorshift64*: tiny, fast and fully determined by its 64-bit state. */
static uint64_t xorshift_next(uint64_t *state)
{
	uint64_t x = *state;

	x ^= x >> 12;
	x ^= x << 25;
	x ^= x >> 27;
	*state = x;
	return x * 0x2545F4914F6CDD1DULL;
}

uint64_t model_seed_for(uint32_t module_index, uint32_t index)
{
	return splitmix64(MODEL_SEED_BASE ^
			  ((uint64_t)module_index << 32) ^ index);
}

uint32_t model_generate(const struct model_vtable *vt, uint64_t seed,
			uint32_t max_len, struct model_op *trace)
{
	uint64_t state = seed != 0U ? seed : 0x9E3779B97F4A7C15ULL;
	uint32_t length;

	if (max_len > MODEL_TRACE_MAX) {
		max_len = MODEL_TRACE_MAX;
	}
	length = max_len - (uint32_t)(xorshift_next(&state) %
				      (max_len / 2U + 1U));
	for (uint32_t i = 0U; i < length; ++i) {
		const uint64_t r = xorshift_next(&state);
		const uint64_t t = xorshift_next(&state);
		const uint32_t pick = (uint32_t)(t & 0xFFU);

		trace[i].kind = (uint8_t)((r >> 8) % vt->op_kinds);
		trace[i].a = (uint8_t)(r >> 16);
		trace[i].b = (uint8_t)(r >> 24);
		/* Half the ops add no time, so races between two ops at
		 * one instant are exercised; a few jump by seconds.
		 */
		if (pick < 128U) {
			trace[i].dt = 0U;
		} else if (pick < 205U) {
			trace[i].dt = (uint32_t)((t >> 8) % 60U);
		} else {
			trace[i].dt = (uint32_t)((t >> 8) % 4000U);
		}
	}
	return length;
}

int model_run_trace(const struct model_vtable *vt,
		    const struct model_op *trace, uint32_t n,
		    uint32_t *applied)
{
	int code = 0;
	uint32_t done = 0U;

	vt->reset();
	for (uint32_t i = 0U; i < n && code == 0; ++i) {
		code = vt->apply(&trace[i]);
		++done;
		if (code == 0 && vt->audit != NULL &&
		    vt->audit() != 0) {
			model_fail_check = "module audit";
			model_fail_line = 0;
			code = MODEL_VIOLATION_AUDIT;
		}
	}
	if (applied != NULL) {
		*applied = done;
	}
	return code;
}

uint32_t model_shrink(const struct model_vtable *vt,
		      struct model_op *trace, uint32_t n, int code)
{
	struct model_op candidate[MODEL_TRACE_MAX];
	uint32_t applied = 0U;
	uint32_t chunk;

	if (model_run_trace(vt, trace, n, &applied) != code) {
		return n;
	}
	/* Nothing after the first violating op can matter. */
	n = applied;
	chunk = n / 2U != 0U ? n / 2U : 1U;
	while (n > 1U) {
		bool progressed = false;
		uint32_t start = 0U;

		while (start < n) {
			const uint32_t len = (n - start < chunk) ?
					     n - start : chunk;
			uint32_t m = 0U;

			for (uint32_t i = 0U; i < n; ++i) {
				if (i < start || i >= start + len) {
					candidate[m++] = trace[i];
				}
			}
			if (m > 0U &&
			    model_run_trace(vt, candidate, m,
					    &applied) == code) {
				memcpy(trace, candidate,
				       m * sizeof(trace[0]));
				n = m;
				progressed = true;
			} else {
				start += len;
			}
		}
		if (!progressed) {
			if (chunk == 1U) {
				break;
			}
			chunk /= 2U;
		} else if (chunk > n) {
			chunk = n;
		}
	}
	return n;
}

void model_trace_hex(const struct model_op *trace, uint32_t n, char *out,
		     size_t capacity)
{
	static const char digits[] = "0123456789abcdef";
	size_t pos = 0U;

	for (uint32_t i = 0U; i < n && pos + MODEL_HEX_PER_OP + 1U <=
				     capacity; ++i) {
		const uint8_t bytes[7] = {
			trace[i].kind, trace[i].a, trace[i].b,
			(uint8_t)trace[i].dt,
			(uint8_t)(trace[i].dt >> 8),
			(uint8_t)(trace[i].dt >> 16),
			(uint8_t)(trace[i].dt >> 24),
		};

		for (size_t j = 0U; j < sizeof(bytes); ++j) {
			out[pos++] = digits[bytes[j] >> 4];
			out[pos++] = digits[bytes[j] & 0xFU];
		}
	}
	if (capacity > 0U) {
		out[pos] = '\0';
	}
}

uint32_t model_check(const struct model_vtable *vt, uint32_t module_index,
		     uint32_t seeds, bool emit, struct model_stats *stats)
{
	struct model_stats local = { 0 };
	uint32_t printed = 0U;

	for (uint32_t i = 0U; i < seeds; ++i) {
		struct model_op trace[MODEL_TRACE_MAX];
		const uint64_t seed = model_seed_for(module_index, i);
		const uint32_t length = model_generate(
			vt, seed, MODEL_TRACE_MAX, trace);
		uint32_t applied = 0U;
		const int code = model_run_trace(vt, trace, length,
						 &applied);

		++local.seeds;
		local.ops += applied;
		if (code == 0) {
			continue;
		}
		++local.violations;
		if (emit && printed < MODEL_MAX_COUNTEREXAMPLES) {
			char hex[MODEL_TRACE_MAX * MODEL_HEX_PER_OP + 1U];
			const uint32_t shrunk =
				model_shrink(vt, trace, length, code);

			model_trace_hex(trace, shrunk, hex, sizeof(hex));
			model_fail_check = "";
			model_fail_line = 0;
			(void)model_run_trace(vt, trace, shrunk, NULL);
			printk("PQCP_MODEL_COUNTEREXAMPLE module=%s "
			       "seed=%08x%08x violation=%d ops=%u "
			       "trace=%s\n",
			       vt->name, (uint32_t)(seed >> 32),
			       (uint32_t)seed, code, shrunk, hex);
			printk("PQCP_MODEL_NOTE module=%s line=%d check=%s\n",
			       vt->name, model_fail_line, model_fail_check);
			++printed;
		}
	}
	if (emit) {
		printk("PQCP_MODEL_CHECK module=%s seeds=%u ops=%u "
		       "violations=%u status=%s\n",
		       vt->name, local.seeds, local.ops, local.violations,
		       local.violations == 0U ? "PASS" : "FAIL");
	}
	if (stats != NULL) {
		*stats = local;
	}
	return local.violations;
}
```

## src/model_harness.h
```c
/*
 * SPDX-License-Identifier: MIT
 *
 * Model-based stateful property testing harness for the edge security
 * state machines.
 *
 * A model is an abstract specification of one firmware module, written as
 * a small state machine that is deliberately independent of the module's
 * implementation. The harness drives a seeded pseudo-random operation
 * trace through the model and the real module in lock step; every op
 * returns a violation code (0 = conforming) and is followed by the
 * module's own audit, so there are two oracles per step.
 *
 * Violation codes: 0 none, 1 module audit failed (set by the harness),
 * >= 2 model property violations (owned by the model).
 *
 * Marker grammar (one line each, at the start of the line; this is a
 * contract with scripts/run_model_checks.py):
 *
 *   PQCP_MODEL_CHECK module=<m> seeds=<n> ops=<n> violations=<n> status=PASS|FAIL
 *   PQCP_MODEL_COUNTEREXAMPLE module=<m> seed=<hex16> violation=<code> ops=<n> trace=<hex>
 *   PQCP_MODEL_SUMMARY modules=4 traces=<n> ops=<n> violations=0 status=PASS
 *
 * <code> is a decimal integer. <hex> encodes the shrunk trace as 7 bytes
 * per op: kind, a, b, then dt as little-endian u32. <seed> reproduces the
 * unshrunk trace. The positive-control test prints PQCP_MODEL_CONTROL
 * lines instead, so it can never be mistaken for a module counterexample.
 *
 * A counterexample is followed by an advisory diagnostic line (not part of
 * the contract) naming the violated check:
 *
 *   PQCP_MODEL_NOTE module=<m> line=<n> check=<expression>
 */

#ifndef MODEL_HARNESS_H_
#define MODEL_HARNESS_H_

#include <stdbool.h>
#include <stddef.h>
#include <stdint.h>

#define MODEL_TRACE_MAX 64U
#define MODEL_VIOLATION_AUDIT 1
#define MODEL_MAX_COUNTEREXAMPLES 3U
#define MODEL_HEX_PER_OP 14U

/* Record which property fired, then return its violation code. */
extern const char *model_fail_check;
extern int model_fail_line;
#define MODEL_REQUIRE(cond, code)                                     \
	do {                                                          \
		if (!(cond)) {                                        \
			model_fail_check = #cond;                     \
			model_fail_line = __LINE__;                   \
			return (code);                                \
		}                                                     \
	} while (0)

struct model_op {
	uint8_t kind;
	uint8_t a;
	uint8_t b;
	uint32_t dt;
};

struct model_vtable {
	const char *name;
	/* Number of distinct op kinds the generator may produce. */
	uint8_t op_kinds;
	/* Rebuild both the model and the module under test from scratch. */
	void (*reset)(void);
	/* Apply one op to both; return 0 or a violation code >= 2. */
	int (*apply)(const struct model_op *op);
	/* The module's own audit; nonzero is violation code 1. May be NULL. */
	int (*audit)(void);
};

struct model_stats {
	uint32_t seeds;
	uint32_t ops;
	uint32_t violations;
};

uint64_t model_seed_for(uint32_t module_index, uint32_t index);

/* Deterministic: the same (vtable kinds, seed, max_len) gives the same trace. */
uint32_t model_generate(const struct model_vtable *vt, uint64_t seed,
			uint32_t max_len, struct model_op *trace);

/* Reset, then replay; returns the first violation code or 0. */
int model_run_trace(const struct model_vtable *vt,
		    const struct model_op *trace, uint32_t n,
		    uint32_t *applied);

/* ddmin over op indices; returns the 1-minimal length (trace shrunk in place). */
uint32_t model_shrink(const struct model_vtable *vt,
		      struct model_op *trace, uint32_t n, int code);

void model_trace_hex(const struct model_op *trace, uint32_t n, char *out,
		     size_t capacity);

/*
 * Run `seeds` seeded traces. Prints CHECK (and up to
 * MODEL_MAX_COUNTEREXAMPLES COUNTEREXAMPLE) markers when `emit` is set.
 * Returns the number of violating traces.
 */
uint32_t model_check(const struct model_vtable *vt, uint32_t module_index,
		     uint32_t seeds, bool emit, struct model_stats *stats);

#endif /* MODEL_HARNESS_H_ */
```

## src/model_modules.h
```c
/*
 * SPDX-License-Identifier: MIT
 *
 * The model vtables, one per checked module. Module names are part of the
 * marker contract: principal, session, credential, policy.
 */

#ifndef MODEL_MODULES_H_
#define MODEL_MODULES_H_

#include "model_harness.h"

#define MODEL_SEEDS 64U
#define MODEL_MODULE_COUNT 4U

/* Stable module indices: they seed the per-module trace streams. */
enum {
	MODEL_INDEX_PRINCIPAL,
	MODEL_INDEX_SESSION,
	MODEL_INDEX_CREDENTIAL,
	MODEL_INDEX_POLICY,
};

extern const struct model_vtable model_principal_vt;
extern const struct model_vtable model_session_vt;
extern const struct model_vtable model_credential_vt;
extern const struct model_vtable model_policy_vt;

/* Run one module for MODEL_SEEDS traces; fails the calling test on a violation. */
void model_run_module(const struct model_vtable *vt, uint32_t index);

#endif /* MODEL_MODULES_H_ */
```

## src/model_policy.c
```c
/*
 * SPDX-License-Identifier: MIT
 *
 * Abstract model of the policy distributor's epoch discipline
 * (edge_policy_distributor.c). The model keeps the history of epochs that
 * were ever active and the epoch of every bundle staged.
 *
 * Properties (violation codes):
 *   61 D1  the active epoch only changes by a successful promote (to the
 *          promoted bundle's epoch, strictly greater than before) or by a
 *          successful rollback (to an epoch that was active before and is
 *          not greater than the current one)
 *   62 D2  promoting a bundle whose epoch is not greater than the active
 *          epoch never succeeds (no rollback of policy via a stale bundle)
 *   63 D3  rolling back or retiring a bundle leaves every other bundle's
 *          content untouched (the harness audit catches digest breakage)
 *   64     an op returned something other than the specified result
 */

#include "model_modules.h"
#include "test_common.h"

#define BUNDLES 3U
#define ACKS 8U
#define KNOWN 16U

enum { D_EPOCH = 61, D_STALE = 62, D_ID = 63, D_RESULT = 64 };

enum { OP_STAGE, OP_ACK, OP_PROMOTE, OP_ROLLBACK, OP_WAIT };

static const uint8_t op_of[] = {
	OP_STAGE, OP_STAGE, OP_ACK, OP_ACK, OP_PROMOTE, OP_PROMOTE,
	OP_ROLLBACK, OP_WAIT,
};

static struct pqcp_edge_policy_bundle bstore[BUNDLES];
static struct pqcp_edge_policy_ack astore[ACKS];
static struct pqcp_edge_policy_distributor pd;
static uint8_t base_digest[PQCP_EDGE_DIGEST_BYTES];

struct known {
	uint64_t id;
	uint64_t epoch;
	uint8_t seed;
};
static uint64_t staged_total;

static struct known known[KNOWN];
static uint32_t nknown;
static uint64_t history[KNOWN * 2U];
static uint32_t nhistory;
static uint64_t now;

static void reset(void)
{
	memset(known, 0, sizeof(known));
	nknown = 0U;
	staged_total = 0U;
	nhistory = 0U;
	history[nhistory++] = 1U;
	now = T0;
	edge_digest(base_digest, 0x01U);
	zassert_equal(pqcp_edge_policy_distributor_init(
		&pd, bstore, ARRAY_SIZE(bstore), astore, ARRAY_SIZE(astore),
		1U, base_digest), 0);
}

static int audit(void)
{
	return pqcp_edge_policy_distributor_audit(&pd);
}

static bool was_active(uint64_t e)
{
	for (uint32_t i = 0U; i < nhistory; ++i) {
		if (history[i] == e) {
			return true;
		}
	}
	return false;
}

static const struct known *pick(const struct model_op *op)
{
	return nknown == 0U ? NULL : &known[op->a % nknown];
}

static int apply(const struct model_op *op)
{
	const uint64_t before = pd.active_policy_epoch;
	const struct known *k = pick(op);
	int rc;

	now += op->dt % 500U;
	switch (op_of[op->kind % ARRAY_SIZE(op_of)]) {
	case OP_STAGE: {
		uint8_t digest[PQCP_EDGE_DIGEST_BYTES];
		struct pqcp_edge_policy_bundle *b = NULL;
		const uint64_t e = 1U + (op->a % 6U);

		edge_digest(digest, (uint8_t)(0x40U + op->b));
		if (pqcp_edge_policy_stage(&pd, digest, e, now, now,
					   now + 100000U, 1U, 2U, &b) == 0 &&
		    b != NULL) {
			/* ID1: ids are issued 1, 2, 3, ... in staging order. */
			++staged_total;
			MODEL_REQUIRE(b->bundle_id == staged_total, D_ID);
			if (nknown < KNOWN) {
				known[nknown].id = b->bundle_id;
				known[nknown].epoch = b->policy_epoch;
				known[nknown].seed = (uint8_t)(0x40U + op->b);
				++nknown;
			}
		}
		break;
	}
	case OP_ACK:
		if (k != NULL) {
			uint8_t digest[PQCP_EDGE_DIGEST_BYTES];

			/* Acknowledge with the digest the bundle carries, so
			 * promotion can really reach ACTIVE.
			 */
			edge_digest(digest, k->seed);
			(void)pqcp_edge_policy_acknowledge(
				&pd, k->id, op->b % 2U ? "ack-a" : "ack-b",
				digest, 0, now);
		}
		break;
	case OP_PROMOTE:
		if (k == NULL) {
			break;
		}
		rc = pqcp_edge_policy_promote(&pd, k->id, now);
		if (k->epoch <= before) {
			MODEL_REQUIRE(rc != 0, D_STALE);
		}
		if (rc == 0) {
			/* Promotion is staged (STAGED, CANARY, PROMOTED,
			 * ACTIVE): a step either leaves the active epoch
			 * alone or makes this strictly newer bundle active.
			 */
			MODEL_REQUIRE(pd.active_policy_epoch == before ||
				      (pd.active_policy_epoch == k->epoch &&
				       k->epoch > before), D_EPOCH);
			if (pd.active_policy_epoch != before) {
				history[nhistory++ % ARRAY_SIZE(history)] =
					k->epoch;
			}
		}
		break;
	case OP_ROLLBACK:
		if (k == NULL) {
			break;
		}
		if (pqcp_edge_policy_rollback(&pd, k->id, now) == 0 &&
		    pd.active_policy_epoch != before) {
			MODEL_REQUIRE(pd.active_policy_epoch < before &&
				      was_active(pd.active_policy_epoch),
				      D_EPOCH);
		}
		break;
	default:
		break;
	}
	/* Active epoch changes are only legal through promote/rollback. */
	if (op_of[op->kind % ARRAY_SIZE(op_of)] != OP_PROMOTE &&
	    op_of[op->kind % ARRAY_SIZE(op_of)] != OP_ROLLBACK) {
		MODEL_REQUIRE(pd.active_policy_epoch == before, D_EPOCH);
	}
	return 0;
}

const struct model_vtable model_policy_vt = {
	.name = "policy",
	.op_kinds = ARRAY_SIZE(op_of),
	.reset = reset,
	.apply = apply,
	.audit = audit,
};
```

## src/model_principal.c
```c
/*
 * SPDX-License-Identifier: MIT
 *
 * Abstract model of the principal directory's quarantine and revocation
 * lifecycle (edge_identity_directory.c).
 *
 * The model tracks only what the specification promises per principal:
 * whether it is registered, whether it has been revoked (permanent), and
 * whether a quarantine is in force. A quarantine is IN FORCE while it was
 * imposed and its deadline (0 = indefinite) has not passed; being in force
 * is a function of time alone. Everything the module does to a principal
 * under quarantine, whatever the op, must preserve that.
 *
 * Properties (violation codes):
 *   11 P1  observe on an in-force quarantine is refused with -EACCES and
 *          changes nothing, whatever the credential expiry says
 *   12 P2  re-registration never changes state, deadline or risk of an
 *          in-force quarantine
 *   13 P3  tick never moves an in-force quarantine out of QUARANTINED
 *   14 P4  a revoked principal never becomes anything but REVOKED, and
 *          every op that would resurrect it is refused
 *   15 an op returned something other than the specified result
 *   16 the directory disagrees with the model about a principal
 */

#include <limits.h>

#include "model_modules.h"
#include "test_common.h"

#define PIDS 3U

enum {
	P_OBSERVE_HELD = 11,
	P_REREGISTER = 12,
	P_TICK = 13,
	P_REVOKED = 14,
	P_RESULT = 15,
	P_STATE = 16,
};

enum {
	OP_REGISTER,
	OP_REREGISTER,
	OP_OBSERVE,
	OP_QUARANTINE,
	OP_RELEASE,
	OP_REVOKE,
	OP_TICK,
	OP_ADVANCE,
	OP_KINDS,
};

static const char *const ids[PIDS] = { "xa", "yb", "zc" };

struct principal_model {
	bool registered;
	bool revoked;
	bool quarantined;
	uint64_t until;
	uint64_t expires;
	uint64_t revocation_epoch;
	uint32_t epoch;
};

struct principal_snapshot {
	bool held;
	enum pqcp_edge_principal_state state;
	uint64_t until;
	uint32_t risk;
};

static struct pqcp_edge_principal store[4];
static struct pqcp_edge_principal_directory dir;
static struct principal_model model[PIDS];
static uint64_t now;

static bool held(uint32_t i)
{
	return model[i].registered && !model[i].revoked &&
	       model[i].quarantined &&
	       (model[i].until == 0U || now < model[i].until);
}

static void reset(void)
{
	memset(model, 0, sizeof(model));
	now = T0;
	zassert_equal(pqcp_edge_principal_directory_init(
		&dir, store, ARRAY_SIZE(store)), 0);
}

static int audit(void)
{
	return pqcp_edge_principal_audit(&dir);
}

/*
 * Whole-directory invariants after every op. `code` names the property the
 * current op is responsible for when an in-force quarantine is disturbed.
 */
static int check_all(const struct principal_snapshot *before,
		     int exempt, int code)
{
	for (uint32_t i = 0U; i < PIDS; ++i) {
		struct pqcp_edge_principal *p = NULL;
		const int rc = pqcp_edge_principal_find(&dir, ids[i], &p);

		if (!model[i].registered) {
			MODEL_REQUIRE(rc == -ENOENT, P_STATE);
			continue;
		}
		MODEL_REQUIRE(rc == 0 && p != NULL, P_STATE);
		MODEL_REQUIRE(p->credential_expires_at_ms ==
			      model[i].expires, P_STATE);
		if (model[i].revoked) {
			MODEL_REQUIRE(p->state ==
				      PQCP_EDGE_PRINCIPAL_REVOKED,
				      P_REVOKED);
			continue;
		}
		MODEL_REQUIRE(p->state != PQCP_EDGE_PRINCIPAL_REVOKED,
			      P_STATE);
		if (held(i)) {
			MODEL_REQUIRE(p->state ==
				      PQCP_EDGE_PRINCIPAL_QUARANTINED &&
				      p->quarantine_until_ms ==
				      model[i].until, code);
		}
		if (before[i].held && (int)i != exempt) {
			MODEL_REQUIRE(p->state == before[i].state &&
				      p->quarantine_until_ms ==
				      before[i].until &&
				      p->risk_score == before[i].risk,
				      code);
		}
	}
	return 0;
}

static int apply(const struct model_op *op)
{
	const uint32_t i = op->a % PIDS;
	struct principal_model *pm = &model[i];
	struct principal_snapshot before[PIDS];
	int exempt = -1;
	int check_code = P_STATE;
	int rc;

	now += op->dt;
	for (uint32_t k = 0U; k < PIDS; ++k) {
		struct pqcp_edge_principal *p = NULL;

		before[k].held = held(k);
		if (before[k].held &&
		    pqcp_edge_principal_find(&dir, ids[k], &p) == 0) {
			before[k].state = p->state;
			before[k].until = p->quarantine_until_ms;
			before[k].risk = p->risk_score;
		}
	}

	switch (op->kind % OP_KINDS) {
	case OP_REGISTER:
	case OP_REREGISTER: {
		struct pqcp_edge_principal p;
		const uint32_t epoch = pm->registered ?
			pm->epoch + (op->kind % OP_KINDS == OP_REREGISTER) :
			1U;
		const uint64_t base =
			pm->registered && pm->expires > now ?
			pm->expires : now;
		const uint64_t expires =
			base + 300U + (uint64_t)(op->b % 16U) * 200U;

		edge_make_principal(&p, ids[i], CAP_ALL,
				    (op->b >> 4) & 1U ?
				    PQCP_EDGE_TRUST_ATTESTED :
				    PQCP_EDGE_TRUST_AUTHENTICATED,
				    expires);
		p.credential_epoch = epoch;
		rc = pqcp_edge_principal_register(&dir, &p, now);
		if (pm->revoked) {
			MODEL_REQUIRE(rc == -EKEYREJECTED, P_REVOKED);
		} else {
			MODEL_REQUIRE(rc == 0, P_RESULT);
			pm->registered = true;
			pm->expires = expires;
			pm->epoch = epoch;
		}
		check_code = P_REREGISTER;
		break;
	}
	case OP_OBSERVE: {
		static const uint32_t risks[4] = { 0U, 400U, 650U, 950U };
		const uint32_t risk = risks[op->b % 4U];
		const bool was_held = held(i);

		rc = pqcp_edge_principal_observe(
			&dir, ids[i], risk, PQCP_EDGE_TRUST_AUTHENTICATED,
			true, now);
		if (!pm->registered) {
			MODEL_REQUIRE(rc == -ENOENT, P_RESULT);
		} else if (pm->revoked) {
			MODEL_REQUIRE(rc == -EKEYREVOKED, P_REVOKED);
		} else if (was_held) {
			MODEL_REQUIRE(rc == -EACCES, P_OBSERVE_HELD);
		} else if (pm->expires <= now) {
			MODEL_REQUIRE(rc == -EKEYEXPIRED, P_RESULT);
			pm->quarantined = false;
		} else if (risk >= 900U) {
			MODEL_REQUIRE(rc == -EACCES, P_RESULT);
			pm->quarantined = true;
			pm->until = UINT64_MAX;
		} else {
			MODEL_REQUIRE(rc == 0, P_RESULT);
			pm->quarantined = false;
		}
		check_code = P_OBSERVE_HELD;
		break;
	}
	case OP_QUARANTINE: {
		uint64_t until;

		switch (op->b % 5U) {
		case 0:
			until = 0U;
			break;
		case 1:
			until = now + 50U + (uint64_t)(op->b >> 3) * 10U;
			break;
		case 2:
			until = UINT64_MAX;
			break;
		case 3:
			until = now;
			break;
		default:
			until = now + 1000U;
			break;
		}
		rc = pqcp_edge_principal_quarantine(&dir, ids[i], until);
		if (!pm->registered) {
			MODEL_REQUIRE(rc == -ENOENT, P_RESULT);
		} else if (pm->revoked) {
			MODEL_REQUIRE(rc == -EKEYREVOKED, P_REVOKED);
		} else {
			MODEL_REQUIRE(rc == 0, P_RESULT);
			pm->quarantined = true;
			pm->until = until;
		}
		exempt = (int)i;
		break;
	}
	case OP_RELEASE:
		rc = pqcp_edge_principal_release(&dir, ids[i], now);
		if (!pm->registered) {
			MODEL_REQUIRE(rc == -ENOENT, P_RESULT);
		} else if (pm->revoked) {
			MODEL_REQUIRE(rc == -EKEYREVOKED, P_REVOKED);
		} else if (!pm->quarantined) {
			MODEL_REQUIRE(rc == -EALREADY, P_RESULT);
		} else if (pm->expires <= now) {
			MODEL_REQUIRE(rc == -EKEYEXPIRED, P_RESULT);
		} else {
			MODEL_REQUIRE(rc == 0, P_RESULT);
			pm->quarantined = false;
		}
		exempt = (int)i;
		break;
	case OP_REVOKE: {
		const bool stale = pm->revocation_epoch > 0U &&
				   (op->b & 1U) != 0U;
		const uint64_t epoch = stale ? pm->revocation_epoch :
					       pm->revocation_epoch + 1U;

		rc = pqcp_edge_principal_revoke(&dir, ids[i], epoch, now);
		if (!pm->registered) {
			MODEL_REQUIRE(rc == -ENOENT, P_RESULT);
		} else if (stale) {
			MODEL_REQUIRE(rc == -ESTALE, P_RESULT);
		} else {
			MODEL_REQUIRE(rc == 0, P_RESULT);
			pm->revoked = true;
			pm->revocation_epoch = epoch;
		}
		exempt = (int)i;
		break;
	}
	case OP_TICK: {
		uint32_t changed = 0U;

		MODEL_REQUIRE(pqcp_edge_principal_tick(&dir, now,
						       &changed) == 0,
			      P_RESULT);
		for (uint32_t k = 0U; k < PIDS; ++k) {
			/* A finite deadline that has passed ends the
			 * quarantine; indefinite ones never lapse.
			 */
			if (model[k].registered && !model[k].revoked &&
			    model[k].quarantined &&
			    model[k].until != 0U &&
			    model[k].until != UINT64_MAX &&
			    now >= model[k].until) {
				model[k].quarantined = false;
			}
		}
		check_code = P_TICK;
		break;
	}
	default:
		break;
	}

	return check_all(before, exempt, check_code);
}

const struct model_vtable model_principal_vt = {
	.name = "principal",
	.op_kinds = OP_KINDS,
	.reset = reset,
	.apply = apply,
	.audit = audit,
};
```

## src/model_session.c
```c
/*
 * SPDX-License-Identifier: MIT
 *
 * Abstract model of the session registry's slot and quota accounting
 * (edge_session_registry.c) together with the principal directory it
 * charges.
 *
 * The model is a ledger: every session ever opened, whether it is still
 * live (not yet closed), and per principal how many are live. A session
 * holds a registry slot and a principal quota unit from a successful open
 * until its single successful close, and nothing else changes that.
 * Expiry, failures and rekeys alter a session's lifecycle state but never
 * its ledger entry.
 *
 * Properties (violation codes):
 *   21 S1  the directory's active_sessions equals the ledger's live count
 *          after every op, and the registry holds exactly one unreleased
 *          slot per live session
 *   22 S2  an open succeeds exactly when the principal is active, under
 *          its quota and the registry has fewer live sessions than slots,
 *          so slots of closed sessions must be reusable and never leak
 *   23 S3  closing an already closed session never succeeds and never
 *          changes any count
 *   24 ID1 the n-th successful open issues session id n (first id is 1)
 *   25 an op returned something other than the specified result
 */

#include "model_modules.h"
#include "test_common.h"

#define SLOTS 3U
#define PRINCIPALS 2U
#define QUOTA 2U
#define LIFETIME_MS 100000U

enum {
	S_COUNTS = 21,
	S_OPEN = 22,
	S_DOUBLE_CLOSE = 23,
	S_ID = 24,
	S_RESULT = 25,
};

enum {
	OP_OPEN,
	OP_CLOSE,
	OP_DEGRADE,
	OP_ACTIVATE,
	OP_ACCOUNT,
	OP_TICK,
};

/* Opens and closes dominate: slot pressure is where the defects live. */
static const uint8_t op_of[] = {
	OP_OPEN, OP_OPEN, OP_OPEN, OP_OPEN,
	OP_CLOSE, OP_CLOSE, OP_CLOSE, OP_CLOSE,
	OP_DEGRADE, OP_ACTIVATE, OP_ACCOUNT, OP_TICK,
};

static const char *const ids[PRINCIPALS] = { "sa", "sb" };

struct ledger_entry {
	uint64_t id;
	uint8_t principal;
	bool live;
};

static struct pqcp_edge_principal pstore[PRINCIPALS];
static struct pqcp_edge_principal_directory dir;
static struct pqcp_edge_session sstore[SLOTS];
static struct pqcp_edge_session_registry reg;
static uint8_t binding[PQCP_EDGE_DIGEST_BYTES];

static struct ledger_entry ledger[MODEL_TRACE_MAX];
static uint32_t issued;
static uint32_t live[PRINCIPALS];
static bool active[PRINCIPALS];
static uint32_t live_total;
static uint64_t next_id;
static uint64_t now;

static void reset(void)
{
	memset(ledger, 0, sizeof(ledger));
	memset(live, 0, sizeof(live));
	issued = 0U;
	live_total = 0U;
	next_id = 1U;
	now = T0;
	zassert_equal(pqcp_edge_principal_directory_init(
		&dir, pstore, ARRAY_SIZE(pstore)), 0);
	for (uint32_t i = 0U; i < PRINCIPALS; ++i) {
		struct pqcp_edge_principal p;

		edge_make_principal(&p, ids[i], CAP_ALL,
				    PQCP_EDGE_TRUST_ATTESTED,
				    T0 + 100000000ULL);
		p.maximum_sessions = QUOTA;
		zassert_equal(pqcp_edge_principal_register(&dir, &p, T0), 0);
		active[i] = true;
	}
	zassert_equal(pqcp_edge_session_registry_init(
		&reg, sstore, ARRAY_SIZE(sstore)), 0);
	edge_digest(binding, 0x33U);
}

static int audit(void)
{
	int rc = pqcp_edge_session_registry_audit(&reg);

	return rc != 0 ? rc : pqcp_edge_principal_audit(&dir);
}

static struct pqcp_edge_route make_route(const char *principal_id)
{
	struct pqcp_edge_route r;

	memset(&r, 0, sizeof(r));
	r.schema_version = PQCP_EDGE_SCHEMA_VERSION;
	r.route_id = 1U;
	SETSTR(r.source_principal_id, principal_id);
	SETSTR(r.service_id, "svc");
	SETSTR(r.endpoint_id, "ep");
	SETSTR(r.source_zone, "zone-a");
	SETSTR(r.destination_zone, "zone-a");
	r.expires_at_ms = now + 1000000000ULL;
	r.occupied = true;
	return r;
}

static int check_counts(void)
{
	uint32_t unreleased = 0U;

	for (uint32_t i = 0U; i < PRINCIPALS; ++i) {
		struct pqcp_edge_principal *p = NULL;

		MODEL_REQUIRE(pqcp_edge_principal_find(&dir, ids[i], &p) ==
			      0 && p != NULL, S_RESULT);
		MODEL_REQUIRE(p->active_sessions == live[i], S_COUNTS);
	}
	for (uint32_t i = 0U; i < SLOTS; ++i) {
		if (sstore[i].occupied && !sstore[i].principal_released) {
			++unreleased;
		}
	}
	MODEL_REQUIRE(unreleased == live_total, S_COUNTS);
	return 0;
}

/* A session id the op names: an issued one, or an unknown one. */
static uint64_t target(const struct model_op *op, struct ledger_entry **entry)
{
	*entry = NULL;
	if (issued == 0U || (op->b & 0x80U) != 0U) {
		return 1000U + op->a;
	}
	*entry = &ledger[op->a % issued];
	return (*entry)->id;
}

static int apply(const struct model_op *op)
{
	now += op->dt;

	switch (op_of[op->kind % ARRAY_SIZE(op_of)]) {
	case OP_OPEN: {
		const uint32_t p = op->a % PRINCIPALS;
		struct pqcp_edge_route route = make_route(ids[p]);
		struct pqcp_edge_session *s = NULL;
		const int rc = pqcp_edge_session_open(
			&reg, &dir, &route, binding, true, now,
			LIFETIME_MS, &s);

		if (!active[p]) {
			/* A refused principal reports -EACCES, or -EDQUOT
			 * when it is also at quota; never success.
			 */
			MODEL_REQUIRE(rc == -EACCES || rc == -EDQUOT,
				      S_OPEN);
		} else if (live[p] >= QUOTA) {
			MODEL_REQUIRE(rc == -EDQUOT, S_OPEN);
		} else if (live_total >= SLOTS) {
			MODEL_REQUIRE(rc == -ENOSPC, S_OPEN);
		} else {
			MODEL_REQUIRE(rc == 0 && s != NULL, S_OPEN);
			MODEL_REQUIRE(s->session_id == next_id, S_ID);
			ledger[issued].id = next_id;
			ledger[issued].principal = (uint8_t)p;
			ledger[issued].live = true;
			++issued;
			++next_id;
			++live[p];
			++live_total;
		}
		break;
	}
	case OP_CLOSE: {
		struct ledger_entry *e;
		const uint64_t id = target(op, &e);
		const int result = (op->b & 1U) != 0U ? -EIO : 0;
		const int rc = pqcp_edge_session_close(&reg, &dir, id,
							result, now);

		if (e == NULL) {
			MODEL_REQUIRE(rc == -ENOENT, S_RESULT);
		} else if (e->live) {
			MODEL_REQUIRE(rc == 0, S_RESULT);
			e->live = false;
			--live[e->principal];
			--live_total;
		} else {
			/* Closed already: -EALREADY while its slot still
			 * remembers it, -ENOENT once the slot was reused.
			 */
			MODEL_REQUIRE(rc == -EALREADY || rc == -ENOENT,
				      S_DOUBLE_CLOSE);
		}
		break;
	}
	case OP_DEGRADE:
	case OP_ACTIVATE: {
		const uint32_t p = op->a % PRINCIPALS;
		const bool up = op_of[op->kind % ARRAY_SIZE(op_of)] ==
				OP_ACTIVATE;

		MODEL_REQUIRE(pqcp_edge_principal_observe(
			&dir, ids[p], up ? 0U : 700U,
			PQCP_EDGE_TRUST_AUTHENTICATED, true, now) == 0,
			S_RESULT);
		active[p] = up;
		break;
	}
	case OP_ACCOUNT: {
		struct ledger_entry *e;
		const uint64_t id = target(op, &e);

		/* Failure accounting may push a session to FAILED but must
		 * never release its slot or quota: only close does.
		 */
		(void)pqcp_edge_session_account(&reg, id, 10U, 10U, false,
						now);
		break;
	}
	default: {
		uint32_t changed = 0U;

		MODEL_REQUIRE(pqcp_edge_session_tick(&reg, now, &changed) ==
			      0, S_RESULT);
		break;
	}
	}
	return check_counts();
}

const struct model_vtable model_session_vt = {
	.name = "session",
	.op_kinds = ARRAY_SIZE(op_of),
	.reset = reset,
	.apply = apply,
	.audit = audit,
};
```

## src/test_harness.c
```c
/*
 * SPDX-License-Identifier: MIT
 *
 * Positive controls for the model harness. A checker that cannot fail
 * proves nothing, so these feed a deliberately broken fake module through
 * the real generator, oracle and shrinker and require a counterexample
 * that shrinks to the known minimal trace.
 */

#include <limits.h>
#include <string.h>

#include <zephyr/sys/printk.h>

#include "model_harness.h"
#include <zephyr/ztest.h>

/*
 * Fake module: arm / disarm gate a counter. The planted defect is a
 * property violation (code 77) once `fake_threshold` increments landed
 * while armed. Disarm never resets the counter, so the unique 1-minimal
 * failing trace is [arm, inc x threshold].
 */
enum { FAKE_ARM, FAKE_INC, FAKE_DISARM, FAKE_NOP, FAKE_KINDS };
#define FAKE_VIOLATION 77

static uint32_t fake_hits;
static bool fake_armed;
static uint32_t fake_threshold;
static uint32_t fake_audit_limit;

static void fake_reset(void)
{
	fake_hits = 0U;
	fake_armed = false;
}

static int fake_apply(const struct model_op *op)
{
	switch (op->kind) {
	case FAKE_ARM:
		fake_armed = true;
		break;
	case FAKE_INC:
		if (fake_armed) {
			++fake_hits;
		}
		break;
	case FAKE_DISARM:
		fake_armed = false;
		break;
	default:
		break;
	}
	return fake_hits >= fake_threshold ? FAKE_VIOLATION : 0;
}

static int fake_audit(void)
{
	return fake_hits >= fake_audit_limit ? -1 : 0;
}

static const struct model_vtable fake_vt = {
	.name = "control",
	.op_kinds = FAKE_KINDS,
	.reset = fake_reset,
	.apply = fake_apply,
	.audit = fake_audit,
};

static void fake_configure(uint32_t threshold, uint32_t audit_limit)
{
	fake_threshold = threshold;
	fake_audit_limit = audit_limit;
}

#define OP(k, delta) { .kind = (k), .a = 0, .b = 0, .dt = (delta) }

static void assert_one_minimal(const struct model_op *trace, uint32_t n,
			       int code)
{
	struct model_op cut[MODEL_TRACE_MAX];

	zassert_equal(model_run_trace(&fake_vt, trace, n, NULL), code);
	for (uint32_t skip = 0U; skip < n; ++skip) {
		uint32_t m = 0U;

		for (uint32_t i = 0U; i < n; ++i) {
			if (i != skip) {
				cut[m++] = trace[i];
			}
		}
		zassert_not_equal(
			model_run_trace(&fake_vt, cut, m, NULL), code,
			"op %u of the shrunk trace is removable", skip);
	}
}

ZTEST(edge_model, test_control_hand_built_trace_shrinks)
{
	struct model_op trace[] = {
		OP(FAKE_NOP, 5), OP(FAKE_INC, 0), OP(FAKE_ARM, 3),
		OP(FAKE_DISARM, 0), OP(FAKE_INC, 9), OP(FAKE_ARM, 0),
		OP(FAKE_INC, 1), OP(FAKE_NOP, 0), OP(FAKE_INC, 2),
		OP(FAKE_DISARM, 7), OP(FAKE_ARM, 0), OP(FAKE_INC, 4),
		OP(FAKE_NOP, 0),
	};
	const uint32_t n = ARRAY_SIZE(trace);
	char hex[MODEL_TRACE_MAX * MODEL_HEX_PER_OP + 1U];
	uint32_t shrunk;

	fake_configure(3U, UINT32_MAX);
	zassert_equal(model_run_trace(&fake_vt, trace, n, NULL),
		      FAKE_VIOLATION, "the planted defect must be reachable");
	shrunk = model_shrink(&fake_vt, trace, n, FAKE_VIOLATION);
	zassert_equal(shrunk, 4U, "expected [arm, inc, inc, inc]");
	zassert_equal(trace[0].kind, FAKE_ARM);
	for (uint32_t i = 1U; i < shrunk; ++i) {
		zassert_equal(trace[i].kind, FAKE_INC);
	}
	assert_one_minimal(trace, shrunk, FAKE_VIOLATION);
	model_trace_hex(trace, shrunk, hex, sizeof(hex));
	zassert_equal(strlen(hex), shrunk * MODEL_HEX_PER_OP);
	printk("PQCP_MODEL_CONTROL module=control violation=%d "
	       "original_ops=%u shrunk_ops=%u trace=%s\n",
	       FAKE_VIOLATION, n, shrunk, hex);
}

ZTEST(edge_model, test_control_seeded_counterexamples_shrink)
{
	struct model_stats stats;
	uint32_t found = 0U;

	fake_configure(3U, UINT32_MAX);
	zassert_true(model_check(&fake_vt, 99U, MODEL_TRACE_MAX, false,
				 &stats) > 0U,
		     "oracle never fired on the broken fake");
	for (uint32_t i = 0U; i < 64U; ++i) {
		struct model_op trace[MODEL_TRACE_MAX];
		const uint32_t n = model_generate(
			&fake_vt, model_seed_for(99U, i), MODEL_TRACE_MAX,
			trace);
		uint32_t applied;
		const int code = model_run_trace(&fake_vt, trace, n,
						 &applied);

		if (code == 0) {
			continue;
		}
		++found;
		zassert_equal(code, FAKE_VIOLATION);
		zassert_equal(model_shrink(&fake_vt, trace, n, code), 4U);
		assert_one_minimal(trace, 4U, code);
	}
	zassert_true(found > 0U);
}

ZTEST(edge_model, test_control_audit_oracle_is_violation_one)
{
	struct model_op trace[MODEL_TRACE_MAX];
	uint32_t n;
	uint32_t found = 0U;

	/* The apply-side property never fires; only the audit does. */
	fake_configure(UINT32_MAX, 2U);
	for (uint32_t i = 0U; i < 64U && found == 0U; ++i) {
		n = model_generate(&fake_vt, model_seed_for(98U, i),
				   MODEL_TRACE_MAX, trace);
		if (model_run_trace(&fake_vt, trace, n, NULL) ==
		    MODEL_VIOLATION_AUDIT) {
			++found;
			zassert_equal(model_shrink(&fake_vt, trace, n,
						   MODEL_VIOLATION_AUDIT),
				      3U, "expected [arm, inc, inc]");
		}
	}
	zassert_equal(found, 1U, "audit oracle never fired");
}

ZTEST(edge_model, test_control_conforming_fake_passes)
{
	struct model_stats stats;

	fake_configure(UINT32_MAX, UINT32_MAX);
	zassert_equal(model_check(&fake_vt, 97U, MODEL_TRACE_MAX, false,
				  &stats), 0U);
	zassert_equal(stats.seeds, MODEL_TRACE_MAX);
	zassert_true(stats.ops > 0U);
}

ZTEST(edge_model, test_control_generation_is_deterministic)
{
	struct model_op first[MODEL_TRACE_MAX];
	struct model_op second[MODEL_TRACE_MAX];
	struct model_op other[MODEL_TRACE_MAX];
	char hex_a[MODEL_TRACE_MAX * MODEL_HEX_PER_OP + 1U];
	char hex_b[MODEL_TRACE_MAX * MODEL_HEX_PER_OP + 1U];
	uint32_t na;
	uint32_t nb;
	uint32_t nc;

	na = model_generate(&fake_vt, 0xC0FFEE1234ULL, MODEL_TRACE_MAX,
			    first);
	nb = model_generate(&fake_vt, 0xC0FFEE1234ULL, MODEL_TRACE_MAX,
			    second);
	zassert_equal(na, nb);
	model_trace_hex(first, na, hex_a, sizeof(hex_a));
	model_trace_hex(second, nb, hex_b, sizeof(hex_b));
	zassert_str_equal(hex_a, hex_b, "same seed, different trace");

	nc = model_generate(&fake_vt, 0xC0FFEE1235ULL, MODEL_TRACE_MAX,
			    other);
	model_trace_hex(other, nc, hex_b, sizeof(hex_b));
	zassert_not_equal(strcmp(hex_a, hex_b), 0,
			  "adjacent seeds produced one trace");
	zassert_equal(model_seed_for(1U, 5U), model_seed_for(1U, 5U));
	zassert_not_equal(model_seed_for(1U, 5U), model_seed_for(2U, 5U));
}
```
